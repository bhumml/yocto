## bbb/conf/bblayers.conf
```bitbake
# LAYER_CONF_VERSION is increased each time build/conf/bblayers.conf
# changes incompatibly
LCONF_VERSION = "6"

BBPATH = "${TOPDIR}"
BBFILES ?= ""

BBLAYERS ?= " \
  ${TOPDIR}/../poky-jethro/meta \
  ${TOPDIR}/../poky-jethro/meta-yocto \
  ${TOPDIR}/../poky-jethro/meta-yocto-bsp \
  ${TOPDIR}/../meta-openembedded/meta-oe \
  ${TOPDIR}/../bbb/meta-beagleboard/common-bsp \
  "
BBLAYERS_NON_REMOVABLE ?= " \
  ${TOPDIR}/../poky-jethro/meta \
  ${TOPDIR}/../poky-jethro/meta-yocto \
  "
```

## board/bbb/conf/local.conf
```bitbake
# There are also the following hardware board target machines included for 
# demonstration purposes:
#
# MACHINE ?= "beaglebone-yocto"
MACHINE ??= "qemuarm"
# MACHINE ??= "qemux86-64"

# DL-DIR

DL_DIR ?= "${TOPDIR}/../../downloads"

BB_SRCREV_POLICY = "clear"


# Password

# inherit extrausers
# EXTRA_USERS_PARAMS = "usermod -P p@ssw0rd root;"

# ENABLE SYSTEMD

DISTRO_FEATURES_append = " systemd"
VIRTUAL-RUNTIME_init_manager = "systemd"
DISTRO_FEATURES_BACKFILL_CONSIDERED = "sysvinit"
VIRTUAL-RUNTIME_initscripts = ""
IMX_DEFAULT_DISTRO_FEATURES_append = " systemd"

#
DISTRO ?= "poky"

# We default to rpm:
PACKAGE_CLASSES ?= "package_deb"
#
# SDK target architecture

# We default to enabling the debugging tweaks.
EXTRA_IMAGE_FEATURES ?= "debug-tweaks"

# # MQTT-Application
# PREFERRED_PROVIDER_pomelo-mqtt = " pomelo-mqtt"
# IMAGE_INSTALL_append = " pomelo-mqtt-dev"

# DEV-FEATURES
IMAGE_INSTALL_append = " pomelo-mqtt-dev"

    
BB_DISKMON_DIRS ??= "\
    STOPTASKS,${TMPDIR},1G,100K \
    STOPTASKS,${DL_DIR},1G,100K \
    STOPTASKS,${SSTATE_DIR},1G,100K \
    STOPTASKS,/tmp,100M,100K \
    ABORT,${TMPDIR},100M,1K \
    ABORT,${DL_DIR},100M,1K \
    ABORT,${SSTATE_DIR},100M,1K \
    ABORT,/tmp,10M,1K"

USER_CLASSES ?= "buildstats image-mklibs image-prelink"

#

PATCHRESOLVE = "noop"

BB_DISKMON_DIRS ??= "\
    STOPTASKS,${TMPDIR},1G,100K \
    STOPTASKS,${DL_DIR},1G,100K \
    STOPTASKS,${SSTATE_DIR},1G,100K \
    STOPTASKS,/tmp,100M,100K \
    ABORT,${TMPDIR},100M,1K \
    ABORT,${DL_DIR},100M,1K \
    ABORT,${SSTATE_DIR},100M,1K \
    ABORT,/tmp,10M,1K"


# By default native qemu will build with a builtin VNC server where graphical output can be
# seen. The line below enables the SDL UI frontend too.
PACKAGECONFIG_append_pn-qemu-system-native = " sdl"

# this doesn't mean anything to you.
CONF_VERSION = "1"
```

## board/rpi4/conf/local.conf
```bitbake
MACHINE ?= "raspberrypi4"
# MACHINE ??= "beaglebone-pomelo"
# MACHINE ??= "qemux86-64"

# DL-DIR

DL_DIR ?= "${TOPDIR}/../../downloads"

INHERIT += "rm_work_and_downloads"

CONF_VERSION = "1"
PACKAGE_CLASSES = "package_rpm"
SDKMACHINE = "x86_64"
USER_CLASSES = "buildstats image-mklibs image-prelink"
PATCHRESOLVE = "noop"

EXTRA_IMAGE_FEATURES = "debug-tweaks"

BB_DISKMON_DIRS = "\
    STOPTASKS,${TMPDIR},1G,100K \
    STOPTASKS,${DL_DIR},1G,100K \
    STOPTASKS,${SSTATE_DIR},1G,100K \
    STOPTASKS,/tmp,100M,100K \
    ABORT,${TMPDIR},100M,1K \
    ABORT,${DL_DIR},100M,1K \
    ABORT,${SSTATE_DIR},100M,1K \
    ABORT,/tmp,10M,1K"
```

## build/bbb/bbb-mqtt/conf/local.conf
```bitbake
# MACHINES
MACHINE ?= "beaglebone-yocto"
# Default policy config
#
DISTRO ?= "poky"

# We default to rpm:
PACKAGE_CLASSES ?= "package_rpm"

# We default to enabling the debugging tweaks.
EXTRA_IMAGE_FEATURES ?= "debug-tweaks"

USER_CLASSES ?= "buildstats image-mklibs image-prelink"

BB_NUMBER_THREADS ?= "4"
PARALLEL_MAKE ?= "-j 4"

# By default disable interactive patch resolution (tasks will just fail instead):
PATCHRESOLVE = "noop"


# with very exotic errors.
BB_DISKMON_DIRS ??= "\
    STOPTASKS,${TMPDIR},1G,100K \
    STOPTASKS,${DL_DIR},1G,100K \
    STOPTASKS,${SSTATE_DIR},1G,100K \
    STOPTASKS,/tmp,100M,100K \
    ABORT,${TMPDIR},100M,1K \
    ABORT,${DL_DIR},100M,1K \
    ABORT,${SSTATE_DIR},100M,1K \
    ABORT,/tmp,10M,1K"


PACKAGECONFIG_append_pn-qemu-system-native = " sdl"

CONF_VERSION = "1"
```
